/* single_csi_main.c — SenseThrough single-ESP32 CSI streamer.
 *
 * ONE board is the whole sensor. A single ESP32 can only measure Channel State
 * Information on frames it RECEIVES, so something else has to be the transmitter.
 * This firmware supports the three ways to get that without a second ESP32:
 *
 *   WISP_LINK_MODE_STA      the board joins an existing Wi-Fi network (your router).
 *                           Every frame the AP sends us yields one CSI sample. Traffic
 *                           is generated by (a) the laptop blasting UDP at the board
 *                           (scripts/traffic.py — exact, chosen rate) and/or (b) the
 *                           board pinging its gateway (self-contained fallback).
 *                           The ROUTER is the transmitter. Recommended.
 *
 *   WISP_LINK_MODE_SOFTAP   the board IS the access point; the laptop associates to it
 *                           and blasts UDP. No router, no credentials. The LAPTOP is
 *                           the transmitter (and it is already sitting there running
 *                           the detector over USB).
 *
 *   WISP_LINK_MODE_SNIFFER  fully passive: promiscuous mode on one channel, CSI from
 *                           whatever is already on the air (AP beacons, ~10 Hz). No
 *                           association, no credentials, no traffic to generate — but
 *                           the packet rate is not ours to control.
 *
 * Output is one line per CSI packet on the UART, in the CSI_DATA format
 * wisp/ingest/parser.py already understands (it reads the trailing [...] I/Q block):
 *
 *   CSI_DATA,SINGLE,<mac>,<rssi>,<rate>,<sig_mode>,<mcs>,<bandwidth>,<smoothing>,
 *   <not_sounding>,<aggregation>,<stbc>,<fec_coding>,<sgi>,<noise_floor>,<ampdu_cnt>,
 *   <channel>,<secondary_channel>,<local_timestamp_us>,<ant>,<sig_len>,<rx_state>,
 *   <len>,[<i0> <q0> <i1> <q1> ...]
 *
 * Two non-CSI_DATA line types are also printed (the Python reader ignores anything that
 * does not start with CSI_DATA, and uses these for diagnostics):
 *
 *   CSI_INFO,...   at boot and on link-up: mode, subcarrier count, UDP port, and the
 *                  board IP. The server auto-discovers that IP from this line to aim its
 *                  traffic generator — see wisp/source/live_reader.py.
 *   CSI_STAT,...   every CONFIG_WISP_STAT_INTERVAL_S seconds: measured packet rate,
 *                  queue drops, RSSI, link state. This is the field diagnostic.
 *
 * Design notes that matter on real hardware:
 *
 * - CSI arrives in the Wi-Fi task callback. Printing ~450 bytes there would block that
 *   task for milliseconds and cost us packets, so the callback only copies into a queue;
 *   a low-priority task does the UART work. A full queue drops the sample and bumps a
 *   counter that CSI_STAT reports — visible loss, never silent stalls.
 * - LLTF-only CSI (the default) gives a CONSTANT subcarrier width. The 2-board rig had to
 *   lock onto a dominant width and discard odd-sized packets because HT-LTF and LLTF
 *   frames interleave; with LLTF-only that whole class of problem disappears.
 * - The first CSI word is documented as invalid on ESP32, so the first two subcarriers are
 *   always dropped (not conditionally) — that keeps the emitted width constant no matter
 *   what first_word_invalid says, which is what the fixed-width room mask needs.
 * - Power save is disabled: a dozing radio produces bursty, uneven CSI.
 */

#include <stdio.h>
#include <string.h>
#include <stdlib.h>

#include "freertos/FreeRTOS.h"
#include "freertos/task.h"
#include "freertos/queue.h"

#include "esp_event.h"
#include "esp_log.h"
#include "esp_netif.h"
#include "esp_system.h"
#include "esp_timer.h"
#include "esp_wifi.h"
#include "nvs_flash.h"

#include "lwip/err.h"
#include "lwip/sockets.h"
#include "ping/ping_sock.h"

/* MACSTR/MAC2STR moved to esp_mac.h in IDF v5; on v4.x they come with esp_wifi.h. Include
 * it when it exists and define the pair ourselves otherwise, so one source file builds on
 * both without an IDF-version #if. */
#if defined(__has_include)
#  if __has_include("esp_mac.h")
#    include "esp_mac.h"
#  endif
#endif
#ifndef MACSTR
#  define MACSTR "%02x:%02x:%02x:%02x:%02x:%02x"
#  define MAC2STR(a) (a)[0], (a)[1], (a)[2], (a)[3], (a)[4], (a)[5]
#endif

/* Kconfig bools vanish (rather than becoming 0) when unset, which is fine in #if but a
 * compile error in ordinary expressions. Normalize the ones used at runtime. */
#ifdef CONFIG_WISP_CSI_LLTF_ONLY
#  define WISP_LLTF_ONLY 1
#else
#  define WISP_LLTF_ONLY 0
#endif

static const char *TAG = "wisp_csi";

/* ------------------------------------------------------------------ tunables */

#define CSI_MAX_BYTES       384     /* max CSI payload we forward (LLTF-only needs 124) */
#define CSI_DROP_LEAD_BYTES 4       /* first word (2 subcarriers) is invalid -> always drop */

typedef struct {
    uint8_t  mac[6];
    int8_t   rssi;
    uint8_t  rate;
    uint8_t  sig_mode;
    uint8_t  mcs;
    uint8_t  bandwidth;
    uint8_t  smoothing;
    uint8_t  not_sounding;
    uint8_t  aggregation;
    uint8_t  stbc;
    uint8_t  fec_coding;
    uint8_t  sgi;
    int8_t   noise_floor;
    uint8_t  ampdu_cnt;
    uint8_t  channel;
    uint8_t  secondary_channel;
    uint8_t  ant;
    uint16_t sig_len;
    uint8_t  rx_state;
    uint32_t timestamp;
    uint16_t len;
    int8_t   buf[CSI_MAX_BYTES];
} csi_record_t;

static QueueHandle_t     s_csi_q;
static volatile uint32_t s_dropped;     /* queue-full drops since boot */
static volatile uint32_t s_emitted;     /* lines printed since boot */
static volatile bool     s_link_up;
static uint8_t           s_filter_mac[6];
static bool              s_filter_on;
static char              s_ip[16] = "0.0.0.0";

/* ------------------------------------------------------------------ helpers */

static bool parse_mac(const char *s, uint8_t out[6])
{
    unsigned v[6];
    if (!s || strlen(s) < 17) return false;
    if (sscanf(s, "%x:%x:%x:%x:%x:%x", &v[0], &v[1], &v[2], &v[3], &v[4], &v[5]) != 6) return false;
    for (int i = 0; i < 6; i++) out[i] = (uint8_t)v[i];
    return true;
}

/* ------------------------------------------------------------------ CSI path */

static void csi_rx_cb(void *ctx, wifi_csi_info_t *info)
{
    if (!info || !info->buf || info->len <= CSI_DROP_LEAD_BYTES) return;

    /* One transmitter only. Mixing CSI from several senders mixes several radio channels
     * into one "motion" signal, which is meaningless. In STA mode this filter is pinned to
     * the BSSID we associated with; in sniffer mode set it in menuconfig. */
    if (s_filter_on && memcmp(info->mac, s_filter_mac, 6) != 0) return;

    csi_record_t rec;
    const wifi_pkt_rx_ctrl_t *rx = &info->rx_ctrl;
    uint16_t len = (uint16_t)info->len - CSI_DROP_LEAD_BYTES;
    if (len > CSI_MAX_BYTES) len = CSI_MAX_BYTES;
    len &= (uint16_t)~1u;                        /* keep whole I/Q pairs */

    memcpy(rec.mac, info->mac, 6);
    rec.rssi              = rx->rssi;
    rec.rate              = rx->rate;
    rec.sig_mode          = rx->sig_mode;
    rec.mcs               = rx->mcs;
    rec.bandwidth         = rx->cwb;
    rec.smoothing         = rx->smoothing;
    rec.not_sounding      = rx->not_sounding;
    rec.aggregation       = rx->aggregation;
    rec.stbc              = rx->stbc;
    rec.fec_coding        = rx->fec_coding;
    rec.sgi               = rx->sgi;
    rec.noise_floor       = rx->noise_floor;
    rec.ampdu_cnt         = rx->ampdu_cnt;
    rec.channel           = rx->channel;
    rec.secondary_channel = rx->secondary_channel;
    rec.ant               = rx->ant;
    rec.sig_len           = rx->sig_len;
    rec.rx_state          = rx->rx_state;
    rec.timestamp         = (uint32_t)(esp_timer_get_time() & 0xFFFFFFFF);
    rec.len               = len;
    memcpy(rec.buf, info->buf + CSI_DROP_LEAD_BYTES, len);

    /* Never block the Wi-Fi task: drop and count instead (CSI_STAT reports it). */
    if (xQueueSend(s_csi_q, &rec, 0) != pdTRUE) s_dropped++;
}

static void csi_print_task(void *arg)
{
    static char line[CSI_MAX_BYTES * 5 + 256];
    csi_record_t rec;
    uint32_t win_start = (uint32_t)(esp_timer_get_time() / 1000);
    uint32_t win_count = 0;

    for (;;) {
        if (xQueueReceive(s_csi_q, &rec, pdMS_TO_TICKS(200)) == pdTRUE) {
            int n = snprintf(line, sizeof(line),
                "CSI_DATA,SINGLE," MACSTR ",%d,%u,%u,%u,%u,%u,%u,%u,%u,%u,%u,%d,%u,%u,%u,%u,%u,%u,%u,%u,[",
                MAC2STR(rec.mac), rec.rssi, rec.rate, rec.sig_mode, rec.mcs, rec.bandwidth,
                rec.smoothing, rec.not_sounding, rec.aggregation, rec.stbc, rec.fec_coding,
                rec.sgi, rec.noise_floor, rec.ampdu_cnt, rec.channel, rec.secondary_channel,
                (unsigned)rec.timestamp, rec.ant, rec.sig_len, rec.rx_state, rec.len);
            for (uint16_t i = 0; i < rec.len && n < (int)sizeof(line) - 8; i++) {
                n += snprintf(line + n, sizeof(line) - n, i ? " %d" : "%d", rec.buf[i]);
            }
            snprintf(line + n, sizeof(line) - n, "]\n");
            fputs(line, stdout);
            s_emitted++;
            win_count++;
        }

        uint32_t now = (uint32_t)(esp_timer_get_time() / 1000);
        if (now - win_start >= CONFIG_WISP_STAT_INTERVAL_S * 1000u) {
            float secs = (now - win_start) / 1000.0f;
            wifi_ap_record_t ap;
            int rssi = 0;
            if (esp_wifi_sta_get_ap_info(&ap) == ESP_OK) rssi = ap.rssi;
            printf("CSI_STAT,rate_hz=%.1f,packets=%u,dropped=%u,link=%s,rssi=%d,ip=%s\n",
                   secs > 0 ? win_count / secs : 0.0f, (unsigned)s_emitted,
                   (unsigned)s_dropped, s_link_up ? "up" : "down", rssi, s_ip);
            win_start = now;
            win_count = 0;
        }
    }
}

static void csi_enable(void)
{
    /* LLTF-only is the default: a constant subcarrier width (so the room mask never has to
     * deal with varying packet widths) at a third of the UART bytes. Enable HT-LTF in
     * menuconfig only if you want the extra subcarriers and can afford the bandwidth. */
#if CONFIG_IDF_TARGET_ESP32
    wifi_csi_config_t csi_cfg = {
        .lltf_en           = true,
        .htltf_en          = !WISP_LLTF_ONLY,
        .stbc_htltf2_en    = !WISP_LLTF_ONLY,
        .ltf_merge_en      = true,
        .channel_filter_en = true,
        .manu_scale        = false,
        .shift             = 0,
    };
#else
    /* Newer targets (C5/C6/S3 with the reworked API) use the acquire_* form. */
    wifi_csi_config_t csi_cfg = {
        .enable             = 1,
        .acquire_csi_legacy = 1,
        .acquire_csi_ht20   = !WISP_LLTF_ONLY,
        .acquire_csi_ht40   = 0,
        .val_scale_cfg      = 0,
    };
#endif
    ESP_ERROR_CHECK(esp_wifi_set_csi_config(&csi_cfg));
    ESP_ERROR_CHECK(esp_wifi_set_csi_rx_cb(csi_rx_cb, NULL));
    ESP_ERROR_CHECK(esp_wifi_set_csi(true));
    ESP_LOGI(TAG, "CSI enabled (%s)",
             WISP_LLTF_ONLY ? "LLTF only" : "LLTF + HT-LTF");
}

/* ------------------------------------------------------------------ traffic sources */

/* A UDP sink. The point is not the payload — it is that every datagram the laptop sends
 * arrives as a Wi-Fi frame, and every received frame is one CSI sample. This is how the
 * packet rate becomes something we CHOOSE (scripts/traffic.py --hz) instead of something
 * we hope the router hands us. Received and discarded. */
static void udp_sink_task(void *arg)
{
    char buf[64];
    struct sockaddr_in addr = {
        .sin_family = AF_INET,
        .sin_port = htons(CONFIG_WISP_UDP_PORT),
        .sin_addr.s_addr = htonl(INADDR_ANY),
    };
    for (;;) {
        int sock = socket(AF_INET, SOCK_DGRAM, IPPROTO_IP);
        if (sock < 0) { vTaskDelay(pdMS_TO_TICKS(1000)); continue; }
        if (bind(sock, (struct sockaddr *)&addr, sizeof(addr)) < 0) {
            close(sock);
            vTaskDelay(pdMS_TO_TICKS(1000));
            continue;
        }
        ESP_LOGI(TAG, "UDP sink listening on :%d", CONFIG_WISP_UDP_PORT);
        for (;;) {
            if (recvfrom(sock, buf, sizeof(buf), 0, NULL, NULL) < 0) break;  /* rebuild */
        }
        close(sock);
    }
}

#if CONFIG_WISP_SELF_PING
/* Self-contained fallback traffic: ping the gateway forever. Each echo REPLY is a frame
 * from the router to us, i.e. one CSI sample, with no help from the laptop. Slower and
 * less even than the UDP blast (routers rate-limit ICMP), but it means the board still
 * produces CSI when nothing else is running. */
static esp_ping_handle_t s_ping;

static void ping_end_cb(esp_ping_handle_t h, void *args) { /* count=infinite: never fires */ }

static void start_self_ping(esp_netif_t *netif)
{
    esp_netif_ip_info_t ip;
    if (!netif || esp_netif_get_ip_info(netif, &ip) != ESP_OK || ip.gw.addr == 0) {
        ESP_LOGW(TAG, "no gateway — self-ping not started");
        return;
    }
    ip_addr_t target = { .type = IPADDR_TYPE_V4 };
    target.u_addr.ip4.addr = ip.gw.addr;

    esp_ping_config_t cfg = ESP_PING_DEFAULT_CONFIG();
    cfg.target_addr     = target;
    cfg.count           = ESP_PING_COUNT_INFINITE;
    cfg.interval_ms     = CONFIG_WISP_PING_INTERVAL_MS;
    cfg.timeout_ms      = 300;
    cfg.data_size       = 32;
    cfg.task_stack_size = 4096;

    esp_ping_callbacks_t cbs = { .on_ping_end = ping_end_cb, .cb_args = NULL };
    if (s_ping) { esp_ping_stop(s_ping); esp_ping_delete_session(s_ping); s_ping = NULL; }
    if (esp_ping_new_session(&cfg, &cbs, &s_ping) == ESP_OK) {
        esp_ping_start(s_ping);
        ESP_LOGI(TAG, "self-ping -> gateway every %d ms", CONFIG_WISP_PING_INTERVAL_MS);
    }
}
#endif

/* ------------------------------------------------------------------ wifi bring-up */

static void on_wifi_event(void *arg, esp_event_base_t base, int32_t id, void *data)
{
    if (base == WIFI_EVENT && id == WIFI_EVENT_STA_START) {
        esp_wifi_connect();
    } else if (base == WIFI_EVENT && id == WIFI_EVENT_STA_DISCONNECTED) {
        s_link_up = false;
        s_filter_on = false;
        printf("CSI_LINK,state=disconnected\n");
        vTaskDelay(pdMS_TO_TICKS(1000));
        esp_wifi_connect();
    } else if (base == WIFI_EVENT && id == WIFI_EVENT_STA_CONNECTED) {
        /* Pin the CSI filter to the AP we actually joined: from here on "the channel"
         * means the channel between this board and that one transmitter. */
        wifi_ap_record_t ap;
        if (esp_wifi_sta_get_ap_info(&ap) == ESP_OK) {
            memcpy(s_filter_mac, ap.bssid, 6);
            s_filter_on = true;
            printf("CSI_LINK,state=connected,bssid=" MACSTR ",channel=%u,rssi=%d\n",
                   MAC2STR(ap.bssid), ap.primary, ap.rssi);
        }
    } else if (base == IP_EVENT && id == IP_EVENT_STA_GOT_IP) {
        ip_event_got_ip_t *e = (ip_event_got_ip_t *)data;
        snprintf(s_ip, sizeof(s_ip), IPSTR, IP2STR(&e->ip_info.ip));
        s_link_up = true;
        printf("CSI_INFO,mode=sta,ip=%s,udp_port=%d\n", s_ip, CONFIG_WISP_UDP_PORT);
        printf("CSI_INFO,hint=aim the traffic generator here: "
               "python scripts/traffic.py --host %s --hz 50\n", s_ip);
#if CONFIG_WISP_SELF_PING
        start_self_ping(esp_netif_get_handle_from_ifkey("WIFI_STA_DEF"));
#endif
    } else if (base == WIFI_EVENT && id == WIFI_EVENT_AP_STACONNECTED) {
        wifi_event_ap_staconnected_t *e = (wifi_event_ap_staconnected_t *)data;
        memcpy(s_filter_mac, e->mac, 6);
        s_filter_on = true;
        s_link_up = true;
        printf("CSI_LINK,state=client_joined,mac=" MACSTR "\n", MAC2STR(e->mac));
    } else if (base == WIFI_EVENT && id == WIFI_EVENT_AP_STADISCONNECTED) {
        s_link_up = false;
        s_filter_on = false;
        printf("CSI_LINK,state=client_left\n");
    }
}

static void wifi_common_init(void)
{
    ESP_ERROR_CHECK(esp_netif_init());
    ESP_ERROR_CHECK(esp_event_loop_create_default());
    wifi_init_config_t cfg = WIFI_INIT_CONFIG_DEFAULT();
    ESP_ERROR_CHECK(esp_wifi_init(&cfg));
    ESP_ERROR_CHECK(esp_event_handler_instance_register(WIFI_EVENT, ESP_EVENT_ANY_ID,
                                                        &on_wifi_event, NULL, NULL));
    ESP_ERROR_CHECK(esp_event_handler_instance_register(IP_EVENT, IP_EVENT_STA_GOT_IP,
                                                        &on_wifi_event, NULL, NULL));
    ESP_ERROR_CHECK(esp_wifi_set_storage(WIFI_STORAGE_RAM));
}

#if CONFIG_WISP_LINK_MODE_STA
static void start_sta(void)
{
    esp_netif_create_default_wifi_sta();
    wifi_common_init();
    wifi_config_t wc = { 0 };
    strlcpy((char *)wc.sta.ssid, CONFIG_WISP_WIFI_SSID, sizeof(wc.sta.ssid));
    strlcpy((char *)wc.sta.password, CONFIG_WISP_WIFI_PASSWORD, sizeof(wc.sta.password));
    ESP_ERROR_CHECK(esp_wifi_set_mode(WIFI_MODE_STA));
    ESP_ERROR_CHECK(esp_wifi_set_config(WIFI_IF_STA, &wc));
    ESP_ERROR_CHECK(esp_wifi_start());
    /* A dozing radio gives bursty, uneven CSI — the one setting you must not forget. */
    ESP_ERROR_CHECK(esp_wifi_set_ps(WIFI_PS_NONE));
    csi_enable();
    xTaskCreate(udp_sink_task, "udp_sink", 4096, NULL, 4, NULL);
    printf("CSI_INFO,mode=sta,ssid=%s,state=connecting\n", CONFIG_WISP_WIFI_SSID);
}
#endif

#if CONFIG_WISP_LINK_MODE_SOFTAP
static void start_softap(void)
{
    esp_netif_create_default_wifi_ap();
    wifi_common_init();
    wifi_config_t wc = { 0 };
    strlcpy((char *)wc.ap.ssid, CONFIG_WISP_SOFTAP_SSID, sizeof(wc.ap.ssid));
    strlcpy((char *)wc.ap.password, CONFIG_WISP_SOFTAP_PASSWORD, sizeof(wc.ap.password));
    wc.ap.ssid_len       = strlen(CONFIG_WISP_SOFTAP_SSID);
    wc.ap.channel        = CONFIG_WISP_SOFTAP_CHANNEL;
    wc.ap.max_connection = 2;
    wc.ap.authmode       = strlen(CONFIG_WISP_SOFTAP_PASSWORD) >= 8
                           ? WIFI_AUTH_WPA2_PSK : WIFI_AUTH_OPEN;
    ESP_ERROR_CHECK(esp_wifi_set_mode(WIFI_MODE_AP));
    ESP_ERROR_CHECK(esp_wifi_set_config(WIFI_IF_AP, &wc));
    ESP_ERROR_CHECK(esp_wifi_start());
    ESP_ERROR_CHECK(esp_wifi_set_ps(WIFI_PS_NONE));
    csi_enable();
    xTaskCreate(udp_sink_task, "udp_sink", 4096, NULL, 4, NULL);
    /* The SoftAP address is fixed by the default netif (192.168.4.1) — print it so the
     * laptop knows where to aim scripts/traffic.py after joining this SSID. */
    strlcpy(s_ip, "192.168.4.1", sizeof(s_ip));
    printf("CSI_INFO,mode=softap,ssid=%s,ip=%s,udp_port=%d\n",
           CONFIG_WISP_SOFTAP_SSID, s_ip, CONFIG_WISP_UDP_PORT);
    printf("CSI_INFO,hint=join this SSID then: python scripts/traffic.py --host %s --hz 50\n",
           s_ip);
}
#endif

#if CONFIG_WISP_LINK_MODE_SNIFFER
static void promisc_rx_cb(void *buf, wifi_promiscuous_pkt_type_t type) { /* CSI cb does the work */ }

static void start_sniffer(void)
{
    wifi_common_init();
    ESP_ERROR_CHECK(esp_wifi_set_mode(WIFI_MODE_NULL));
    ESP_ERROR_CHECK(esp_wifi_start());
    ESP_ERROR_CHECK(esp_wifi_set_ps(WIFI_PS_NONE));
    ESP_ERROR_CHECK(esp_wifi_set_promiscuous_rx_cb(&promisc_rx_cb));
    ESP_ERROR_CHECK(esp_wifi_set_promiscuous(true));
    ESP_ERROR_CHECK(esp_wifi_set_channel(CONFIG_WISP_SNIFFER_CHANNEL, WIFI_SECOND_CHAN_NONE));
    csi_enable();
    s_link_up = true;
    printf("CSI_INFO,mode=sniffer,channel=%d\n", CONFIG_WISP_SNIFFER_CHANNEL);
    printf("CSI_INFO,hint=passive: the rate is whatever is on air (beacons ~10 Hz). "
           "Set WISP_MAC_FILTER to one AP for a stable channel.\n");
}
#endif

/* ------------------------------------------------------------------ app_main */

void app_main(void)
{
    esp_err_t err = nvs_flash_init();
    if (err == ESP_ERR_NVS_NO_FREE_PAGES || err == ESP_ERR_NVS_NEW_VERSION_FOUND) {
        ESP_ERROR_CHECK(nvs_flash_erase());
        err = nvs_flash_init();
    }
    ESP_ERROR_CHECK(err);

    s_csi_q = xQueueCreate(CONFIG_WISP_QUEUE_DEPTH, sizeof(csi_record_t));
    if (!s_csi_q) { ESP_LOGE(TAG, "no memory for the CSI queue"); return; }
    /* Priority 5: above idle so the UART keeps draining, below the Wi-Fi task so capture
     * always wins. Drops (reported by CSI_STAT) are preferable to lost packets. */
    xTaskCreate(csi_print_task, "csi_print", 4096, NULL, 5, NULL);

    if (parse_mac(CONFIG_WISP_MAC_FILTER, s_filter_mac)) {
        s_filter_on = true;
        ESP_LOGI(TAG, "CSI filtered to %s", CONFIG_WISP_MAC_FILTER);
    }

#if CONFIG_WISP_LINK_MODE_STA
    start_sta();
#elif CONFIG_WISP_LINK_MODE_SOFTAP
    start_softap();
#elif CONFIG_WISP_LINK_MODE_SNIFFER
    start_sniffer();
#else
#error "Pick a link mode in menuconfig (SenseThrough single-ESP32 CSI)"
#endif
}
